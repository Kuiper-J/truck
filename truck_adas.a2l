/******************************************************************************
* ASAP2 file: truck_adas.a2l
* Code generation for model "truck_adas".
* Model version : 1.1304
* Simulink Coder version : 9.1 (R2019a) 23-Nov-2018
* C++ source code generated on : Sun Dec 27 15:37:01 2020
* Target selection: ert.tlc
* Embedded hardware selection: Intel->x86-64 (Windows64)
* Code generation objective: RAM efficiency
* Validation result: Not run
* (add additional file header information here)
******************************************************************************/ ASAP2_VERSION 1 31
/* Version 1.31 */
/begin PROJECT ProjectName "Project Comment Goes Here"
/begin HEADER "Header Comments go here" /end HEADER
/begin MODULE ModuleName "Module Comment Goes Here"
/begin MOD_PAR "MOD PAR Comment Goes Here" /end MOD_PAR
/begin MOD_COMMON "Mod Common Comment Here" BYTE_ORDER MSB_LAST /end MOD_COMMON
/begin RECORD_LAYOUT Scalar_BOOLEAN FNC_VALUES 1 UBYTE COLUMN_DIR DIRECT /end RECORD_LAYOUT
/begin RECORD_LAYOUT Scalar_UBYTE FNC_VALUES 1 UBYTE COLUMN_DIR DIRECT /end RECORD_LAYOUT
/begin RECORD_LAYOUT Scalar_BYTE FNC_VALUES 1 SBYTE COLUMN_DIR DIRECT /end RECORD_LAYOUT
/begin RECORD_LAYOUT Scalar_UWORD FNC_VALUES 1 UWORD COLUMN_DIR DIRECT /end RECORD_LAYOUT
/begin RECORD_LAYOUT Scalar_SWORD FNC_VALUES 1 SWORD COLUMN_DIR DIRECT /end RECORD_LAYOUT
/begin RECORD_LAYOUT Scalar_ULONG FNC_VALUES 1 ULONG COLUMN_DIR DIRECT /end RECORD_LAYOUT
/begin RECORD_LAYOUT Scalar_LONG FNC_VALUES 1 SLONG COLUMN_DIR DIRECT /end RECORD_LAYOUT
/begin RECORD_LAYOUT Scalar_FLOAT32_IEEE FNC_VALUES 1 FLOAT32_IEEE COLUMN_DIR DIRECT /end RECORD_LAYOUT
/begin RECORD_LAYOUT Scalar_FLOAT64_IEEE FNC_VALUES 1 FLOAT64_IEEE COLUMN_DIR DIRECT /end RECORD_LAYOUT
/begin RECORD_LAYOUT Lookup1D_BOOLEAN FNC_VALUES 1 UBYTE COLUMN_DIR DIRECT /end RECORD_LAYOUT
/begin RECORD_LAYOUT Lookup1D_X_BOOLEAN AXIS_PTS_X 1 UBYTE INDEX_INCR DIRECT /end RECORD_LAYOUT
/begin RECORD_LAYOUT Lookup1D_BYTE FNC_VALUES 1 SBYTE COLUMN_DIR DIRECT /end RECORD_LAYOUT
/begin RECORD_LAYOUT Lookup1D_X_BYTE AXIS_PTS_X 1 SBYTE INDEX_INCR DIRECT /end RECORD_LAYOUT
/begin RECORD_LAYOUT Lookup1D_UBYTE FNC_VALUES 1 UBYTE COLUMN_DIR DIRECT /end RECORD_LAYOUT
/begin RECORD_LAYOUT Lookup1D_X_UBYTE AXIS_PTS_X 1 UBYTE INDEX_INCR DIRECT /end RECORD_LAYOUT
/begin RECORD_LAYOUT Lookup1D_UWORD FNC_VALUES 1 UWORD COLUMN_DIR DIRECT /end RECORD_LAYOUT
/begin RECORD_LAYOUT Lookup1D_X_UWORD AXIS_PTS_X 1 UWORD INDEX_INCR DIRECT /end RECORD_LAYOUT
/begin RECORD_LAYOUT Lookup1D_WORD FNC_VALUES 1 SWORD COLUMN_DIR DIRECT /end RECORD_LAYOUT
/begin RECORD_LAYOUT Lookup1D_X_WORD AXIS_PTS_X 1 SWORD INDEX_INCR DIRECT /end RECORD_LAYOUT
/begin RECORD_LAYOUT Lookup1D_ULONG FNC_VALUES 1 ULONG COLUMN_DIR DIRECT /end RECORD_LAYOUT
/begin RECORD_LAYOUT Lookup1D_X_ULONG AXIS_PTS_X 1 ULONG INDEX_INCR DIRECT /end RECORD_LAYOUT
/begin RECORD_LAYOUT Lookup1D_SLONG FNC_VALUES 1 SLONG COLUMN_DIR DIRECT /end RECORD_LAYOUT
/begin RECORD_LAYOUT Lookup1D_X_LONG AXIS_PTS_X 1 SLONG INDEX_INCR DIRECT /end RECORD_LAYOUT
/begin RECORD_LAYOUT Lookup1D_FLOAT32_IEEE FNC_VALUES 1 FLOAT32_IEEE COLUMN_DIR DIRECT /end RECORD_LAYOUT
/begin RECORD_LAYOUT Lookup1D_X_FLOAT32_IEEE AXIS_PTS_X 1 FLOAT32_IEEE INDEX_INCR DIRECT /end RECORD_LAYOUT
/begin RECORD_LAYOUT Lookup1D_FLOAT64_IEEE FNC_VALUES 1 FLOAT64_IEEE COLUMN_DIR DIRECT /end RECORD_LAYOUT
/begin RECORD_LAYOUT Lookup1D_X_FLOAT64_IEEE AXIS_PTS_X 1 FLOAT64_IEEE INDEX_INCR DIRECT /end RECORD_LAYOUT
/begin RECORD_LAYOUT Lookup2D_BOOLEAN FNC_VALUES 1 UBYTE COLUMN_DIR DIRECT /end RECORD_LAYOUT
/begin RECORD_LAYOUT Lookup2D_X_BOOLEAN AXIS_PTS_X 1 UBYTE INDEX_INCR DIRECT /end RECORD_LAYOUT
/begin RECORD_LAYOUT Lookup2D_UBYTE FNC_VALUES 1 UBYTE COLUMN_DIR DIRECT /end RECORD_LAYOUT
/begin RECORD_LAYOUT Lookup2D_X_UBYTE AXIS_PTS_X 1 UBYTE INDEX_INCR DIRECT /end RECORD_LAYOUT
/begin RECORD_LAYOUT Lookup2D_BYTE FNC_VALUES 1 SBYTE COLUMN_DIR DIRECT /end RECORD_LAYOUT
/begin RECORD_LAYOUT Lookup2D_X_BYTE AXIS_PTS_X 1 SBYTE INDEX_INCR DIRECT /end RECORD_LAYOUT
/begin RECORD_LAYOUT Lookup2D_UWORD FNC_VALUES 1 UWORD COLUMN_DIR DIRECT /end RECORD_LAYOUT
/begin RECORD_LAYOUT Lookup2D_X_UWORD AXIS_PTS_X 1 UWORD INDEX_INCR DIRECT /end RECORD_LAYOUT
/begin RECORD_LAYOUT Lookup2D_WORD FNC_VALUES 1 SWORD COLUMN_DIR DIRECT /end RECORD_LAYOUT
/begin RECORD_LAYOUT Lookup2D_X_WORD AXIS_PTS_X 1 SWORD INDEX_INCR DIRECT /end RECORD_LAYOUT
/begin RECORD_LAYOUT Lookup2D_ULONG FNC_VALUES 1 ULONG COLUMN_DIR DIRECT /end RECORD_LAYOUT
/begin RECORD_LAYOUT Lookup2D_X_ULONG AXIS_PTS_X 1 ULONG INDEX_INCR DIRECT /end RECORD_LAYOUT
/begin RECORD_LAYOUT Lookup2D_LONG FNC_VALUES 1 SLONG COLUMN_DIR DIRECT /end RECORD_LAYOUT
/begin RECORD_LAYOUT Lookup2D_X_LONG AXIS_PTS_X 1 SLONG INDEX_INCR DIRECT /end RECORD_LAYOUT
/begin RECORD_LAYOUT Lookup2D_FLOAT32_IEEE FNC_VALUES 1 FLOAT32_IEEE COLUMN_DIR DIRECT /end RECORD_LAYOUT
/begin RECORD_LAYOUT Lookup2D_X_FLOAT32_IEEE AXIS_PTS_X 1 FLOAT32_IEEE INDEX_INCR DIRECT /end RECORD_LAYOUT
/begin RECORD_LAYOUT Lookup2D_FLOAT64_IEEE FNC_VALUES 1 FLOAT64_IEEE COLUMN_DIR DIRECT /end RECORD_LAYOUT
/begin RECORD_LAYOUT Lookup2D_X_FLOAT64_IEEE AXIS_PTS_X 1 FLOAT64_IEEE INDEX_INCR DIRECT /end RECORD_LAYOUT
/begin CHARACTERISTIC VehStatCo_Stat_DT "" VALUE 0x0000 /* @ECU_Address@VehStatCo_Stat_DT@ */ Scalar_FLOAT64_IEEE 0 truck_adas_CM_double -1.7E+308 1.7E+308 /end CHARACTERISTIC
/begin CHARACTERISTIC Veh_FINISH "" VALUE 0x0000 /* @ECU_Address@Veh_FINISH@ */ Scalar_FLOAT64_IEEE 0 truck_adas_CM_double -1.7E+308 1.7E+308 /end CHARACTERISTIC
/begin CHARACTERISTIC Veh_READY "" VALUE 0x0000 /* @ECU_Address@Veh_READY@ */ Scalar_FLOAT64_IEEE 0 truck_adas_CM_double -1.7E+308 1.7E+308 /end CHARACTERISTIC
/begin CHARACTERISTIC Veh_RUNNING "" VALUE 0x0000 /* @ECU_Address@Veh_RUNNING@ */ Scalar_FLOAT64_IEEE 0 truck_adas_CM_double -1.7E+308 1.7E+308 /end CHARACTERISTIC
/begin CHARACTERISTIC Veh_STANDBY "" VALUE 0x0000 /* @ECU_Address@Veh_STANDBY@ */ Scalar_FLOAT64_IEEE 0 truck_adas_CM_double -1.7E+308 1.7E+308 /end CHARACTERISTIC
/begin CHARACTERISTIC Veh_START "" VALUE 0x0000 /* @ECU_Address@Veh_START@ */ Scalar_FLOAT64_IEEE 0 truck_adas_CM_double -1.7E+308 1.7E+308 /end CHARACTERISTIC
/begin CHARACTERISTIC Veh_STOPPING "" VALUE 0x0000 /* @ECU_Address@Veh_STOPPING@ */ Scalar_FLOAT64_IEEE 0 truck_adas_CM_double -1.7E+308 1.7E+308 /end CHARACTERISTIC
/begin MEASUREMENT Navigation_CMD_st_520_CAN3 "" FLOAT64_IEEE truck_adas_CM_double 0 0 -1.7E+308 1.7E+308 ECU_ADDRESS 0x0000 /* @ECU_Address@Navigation_CMD_st_520_CAN3@ */ /end MEASUREMENT
/begin MEASUREMENT Obj_distance_vision_534_CAN3 "" FLOAT64_IEEE truck_adas_CM_double 0 0 0.0 20.0 ECU_ADDRESS 0x0000 /* @ECU_Address@Obj_distance_vision_534_CAN3@ */ /end MEASUREMENT
/begin MEASUREMENT IMU_Heading_531_CAN3 "" FLOAT64_IEEE truck_adas_CM_double 0 0 -20.0 20.0 ECU_ADDRESS 0x0000 /* @ECU_Address@IMU_Heading_531_CAN3@ */ /end MEASUREMENT
/begin MEASUREMENT ADAS_vel_cur_520_CAN3 "" FLOAT64_IEEE truck_adas_CM_double 0 0 -20.0 20.0 ECU_ADDRESS 0x0000 /* @ECU_Address@ADAS_vel_cur_520_CAN3@ */ /end MEASUREMENT
/begin MEASUREMENT Temp_3_537_CAN3 "" FLOAT64_IEEE truck_adas_CM_double 0 0 -1.7E+308 1.7E+308 ECU_ADDRESS 0x0000 /* @ECU_Address@Temp_3_537_CAN3@ */ /end MEASUREMENT
/begin MEASUREMENT Deta_530_CAN3 "" FLOAT64_IEEE truck_adas_CM_double 0 0 -1.7E+308 1.7E+308 ECU_ADDRESS 0x0000 /* @ECU_Address@Deta_530_CAN3@ */ /end MEASUREMENT
/begin MEASUREMENT Temp_2_537_CAN3 "" FLOAT64_IEEE truck_adas_CM_double 0 0 -1.7E+308 1.7E+308 ECU_ADDRESS 0x0000 /* @ECU_Address@Temp_2_537_CAN3@ */ /end MEASUREMENT
/begin MEASUREMENT ADAS_work_st_512_CAN3 "" FLOAT64_IEEE truck_adas_CM_double 0 0 -1.7E+308 1.7E+308 ECU_ADDRESS 0x0000 /* @ECU_Address@ADAS_work_st_512_CAN3@ */ /end MEASUREMENT
/begin MEASUREMENT Obs_533_CAN3 "" FLOAT64_IEEE truck_adas_CM_double 0 0 -1.7E+308 1.7E+308 ECU_ADDRESS 0x0000 /* @ECU_Address@Obs_533_CAN3@ */ /end MEASUREMENT
/begin MEASUREMENT Temp_1_537_CAN3 "" FLOAT64_IEEE truck_adas_CM_double 0 0 -1.7E+308 1.7E+308 ECU_ADDRESS 0x0000 /* @ECU_Address@Temp_1_537_CAN3@ */ /end MEASUREMENT
/begin MEASUREMENT VelSpd_desire_512_CAN3 "" FLOAT64_IEEE truck_adas_CM_double 0 0 -1.7E+308 1.7E+308 ECU_ADDRESS 0x0000 /* @ECU_Address@VelSpd_desire_512_CAN3@ */ /end MEASUREMENT
/begin MEASUREMENT SteerAngle_desire_512_CAN3 "" FLOAT64_IEEE truck_adas_CM_double 0 0 -1.7E+308 1.7E+308 ECU_ADDRESS 0x0000 /* @ECU_Address@SteerAngle_desire_512_CAN3@ */ /end MEASUREMENT
/begin MEASUREMENT Temp_4_537_CAN3 "" FLOAT64_IEEE truck_adas_CM_double 0 0 -1.7E+308 1.7E+308 ECU_ADDRESS 0x0000 /* @ECU_Address@Temp_4_537_CAN3@ */ /end MEASUREMENT
/begin MEASUREMENT ADAS_HeartBeat_512_CAN3 "" FLOAT64_IEEE truck_adas_CM_double 0 0 -1.7E+308 1.7E+308 ECU_ADDRESS 0x0000 /* @ECU_Address@ADAS_HeartBeat_512_CAN3@ */ /end MEASUREMENT
/begin MEASUREMENT ADAS_Stat_st_533_CAN3 "" FLOAT64_IEEE truck_adas_CM_double 0 0 -1.7E+308 1.7E+308 ECU_ADDRESS 0x0000 /* @ECU_Address@ADAS_Stat_st_533_CAN3@ */ /end MEASUREMENT
/begin MEASUREMENT VehStatCo_Stat_tiCrank_532_CAN3 "" FLOAT64_IEEE truck_adas_CM_double 0 0 -1.7E+308 1.7E+308 ECU_ADDRESS 0x0000 /* @ECU_Address@VehStatCo_Stat_tiCrank_532_CAN3@ */ /end MEASUREMENT
/begin MEASUREMENT VehStatCo_Stat_tiNrm_532_CAN3 "" FLOAT64_IEEE truck_adas_CM_double 0 0 -1.7E+308 1.7E+308 ECU_ADDRESS 0x0000 /* @ECU_Address@VehStatCo_Stat_tiNrm_532_CAN3@ */ /end MEASUREMENT
/begin MEASUREMENT VehStatCo_Stat_tiAftRun_533_CAN3 "" FLOAT64_IEEE truck_adas_CM_double 0 0 -1.7E+308 1.7E+308 ECU_ADDRESS 0x0000 /* @ECU_Address@VehStatCo_Stat_tiAftRun_533_CAN3@ */ /end MEASUREMENT
/begin MEASUREMENT VehStatCo_Stat_st_532_CAN3 "" FLOAT64_IEEE truck_adas_CM_double 0 0 -1.7E+308 1.7E+308 ECU_ADDRESS 0x0000 /* @ECU_Address@VehStatCo_Stat_st_532_CAN3@ */ /end MEASUREMENT
/begin MEASUREMENT Driving_state_530_CAN3 "" FLOAT64_IEEE truck_adas_CM_double 0 0 -1.7E+308 1.7E+308 ECU_ADDRESS 0x0000 /* @ECU_Address@Driving_state_530_CAN3@ */ /end MEASUREMENT
/begin MEASUREMENT Dfp_mp_532_CAN3 "" FLOAT64_IEEE truck_adas_CM_double 0 0 -1.7E+308 1.7E+308 ECU_ADDRESS 0x0000 /* @ECU_Address@Dfp_mp_532_CAN3@ */ /end MEASUREMENT
/begin MEASUREMENT Radar_LatPos_534_CAN3 "" FLOAT64_IEEE truck_adas_CM_double 0 0 0.0 64.0 ECU_ADDRESS 0x0000 /* @ECU_Address@Radar_LatPos_534_CAN3@ */ /end MEASUREMENT
/begin MEASUREMENT VisionObj_LonVel_521_CAN3 "" FLOAT64_IEEE truck_adas_CM_double 0 0 -1.7E+308 1.7E+308 ECU_ADDRESS 0x0000 /* @ECU_Address@VisionObj_LonVel_521_CAN3@ */ /end MEASUREMENT
/begin MEASUREMENT VisionObj_Width_521_CAN3 "" FLOAT64_IEEE truck_adas_CM_double 0 0 -1.7E+308 1.7E+308 ECU_ADDRESS 0x0000 /* @ECU_Address@VisionObj_Width_521_CAN3@ */ /end MEASUREMENT
/begin MEASUREMENT Vision_Length_521_CAN3 "" FLOAT64_IEEE truck_adas_CM_double 0 0 -1.7E+308 1.7E+308 ECU_ADDRESS 0x0000 /* @ECU_Address@Vision_Length_521_CAN3@ */ /end MEASUREMENT
/begin MEASUREMENT Radar_LonPos_534_CAN3 "" FLOAT64_IEEE truck_adas_CM_double 0 0 0.0 64.0 ECU_ADDRESS 0x0000 /* @ECU_Address@Radar_LonPos_534_CAN3@ */ /end MEASUREMENT
/begin MEASUREMENT FLC_UPA_Distance_51_535_CAN3 "" FLOAT64_IEEE truck_adas_CM_double 0 0 -1.7E+308 1.7E+308 ECU_ADDRESS 0x0000 /* @ECU_Address@FLC_UPA_Distance_51_535_CAN3@ */ /end MEASUREMENT
/begin MEASUREMENT FLC_UPA_Status_51_535_CAN3 "" FLOAT64_IEEE truck_adas_CM_double 0 0 -1.7E+308 1.7E+308 ECU_ADDRESS 0x0000 /* @ECU_Address@FLC_UPA_Status_51_535_CAN3@ */ /end MEASUREMENT
/begin MEASUREMENT FLM_UPA_Distance_51_535_CAN3 "" FLOAT64_IEEE truck_adas_CM_double 0 0 -1.7E+308 1.7E+308 ECU_ADDRESS 0x0000 /* @ECU_Address@FLM_UPA_Distance_51_535_CAN3@ */ /end MEASUREMENT
/begin MEASUREMENT FLM_UPA_Status_51_535_CAN3 "" FLOAT64_IEEE truck_adas_CM_double 0 0 -1.7E+308 1.7E+308 ECU_ADDRESS 0x0000 /* @ECU_Address@FLM_UPA_Status_51_535_CAN3@ */ /end MEASUREMENT
/begin MEASUREMENT FRC_UPA_Distance_51_535_CAN3 "" FLOAT64_IEEE truck_adas_CM_double 0 0 -1.7E+308 1.7E+308 ECU_ADDRESS 0x0000 /* @ECU_Address@FRC_UPA_Distance_51_535_CAN3@ */ /end MEASUREMENT
/begin MEASUREMENT FRC_UPA_Status_51_535_CAN3 "" FLOAT64_IEEE truck_adas_CM_double 0 0 -1.7E+308 1.7E+308 ECU_ADDRESS 0x0000 /* @ECU_Address@FRC_UPA_Status_51_535_CAN3@ */ /end MEASUREMENT
/begin MEASUREMENT FRM_UPA_Distance_51_535_CAN3 "" FLOAT64_IEEE truck_adas_CM_double 0 0 -1.7E+308 1.7E+308 ECU_ADDRESS 0x0000 /* @ECU_Address@FRM_UPA_Distance_51_535_CAN3@ */ /end MEASUREMENT
/begin MEASUREMENT FRM_UPA_Status_51_535_CAN3 "" FLOAT64_IEEE truck_adas_CM_double 0 0 -1.7E+308 1.7E+308 ECU_ADDRESS 0x0000 /* @ECU_Address@FRM_UPA_Status_51_535_CAN3@ */ /end MEASUREMENT
/begin MEASUREMENT Time_difference_530_CAN3 "" FLOAT64_IEEE truck_adas_CM_double 0 0 -20.0 20.0 ECU_ADDRESS 0x0000 /* @ECU_Address@Time_difference_530_CAN3@ */ /end MEASUREMENT
/begin MEASUREMENT VehDa_VehSpd_vel_532_CAN3 "" FLOAT64_IEEE truck_adas_CM_double 0 0 -1.7E+308 1.7E+308 ECU_ADDRESS 0x0000 /* @ECU_Address@VehDa_VehSpd_vel_532_CAN3@ */ /end MEASUREMENT
/begin MEASUREMENT VehDa_VehSpd_a_532_CAN3 "" FLOAT64_IEEE truck_adas_CM_double 0 0 -1.7E+308 1.7E+308 ECU_ADDRESS 0x0000 /* @ECU_Address@VehDa_VehSpd_a_532_CAN3@ */ /end MEASUREMENT
/begin MEASUREMENT WarnningLamp_532_CAN3 "" FLOAT64_IEEE truck_adas_CM_double 0 0 -1.7E+308 1.7E+308 ECU_ADDRESS 0x0000 /* @ECU_Address@WarnningLamp_532_CAN3@ */ /end MEASUREMENT
/begin MEASUREMENT VehAcs_IgnKey_st_532_CAN3 "" FLOAT64_IEEE truck_adas_CM_double 0 0 -1.7E+308 1.7E+308 ECU_ADDRESS 0x0000 /* @ECU_Address@VehAcs_IgnKey_st_532_CAN3@ */ /end MEASUREMENT
/begin COMPU_METHOD /* Name of CompuMethod */ truck_adas_CM_double "Q = V" /* Conversion Type */ RAT_FUNC /* Format */ "%15.10" /* Units */ "" /* Coefficients */ COEFFS 0 1 0 0 0 1 /end COMPU_METHOD
/begin GROUP truck_adas "truck_adas" /* Root */ ROOT
 /begin SUB_GROUP Root_TRUCK_ADAS Root_variable_out10 Root_variable_out12 Root_variable_out17 Root_variable_out27 Root_variable_out28 Root_variable_out29 Root_variable_out71 Root_variable_out72 Root_variable_out73 Root_variable_out74 Root_variable_out75 Root_variable_out76 Root_variable_out77 Root_variable_out78 Root_variable_out79 Root_variable_out9 /end SUB_GROUP
/end GROUP
/begin GROUP Root_TRUCK_ADAS "truck_adas/TRUCK_ADAS"
 /begin SUB_GROUP S1_D2_OUTPUT S1_D3_Vehicle S1_D4__Fusion_perception S1_D5_ADAS S1_D6_DSM /end SUB_GROUP
/end GROUP
/begin GROUP Root_variable_out10 "truck_adas/variable_out10" /begin REF_MEASUREMENT Navigation_CMD_st_520_CAN3 /end REF_MEASUREMENT /end GROUP
/begin GROUP Root_variable_out12 "truck_adas/variable_out12" /begin REF_MEASUREMENT Radar_LatPos_534_CAN3 /end REF_MEASUREMENT /end GROUP
/begin GROUP Root_variable_out17 "truck_adas/variable_out17" /begin REF_MEASUREMENT IMU_Heading_531_CAN3 /end REF_MEASUREMENT /end GROUP
/begin GROUP Root_variable_out27 "truck_adas/variable_out27" /begin REF_MEASUREMENT VisionObj_LonVel_521_CAN3 /end REF_MEASUREMENT /end GROUP
/begin GROUP Root_variable_out28 "truck_adas/variable_out28" /begin REF_MEASUREMENT VisionObj_Width_521_CAN3 /end REF_MEASUREMENT /end GROUP
/begin GROUP Root_variable_out29 "truck_adas/variable_out29" /begin REF_MEASUREMENT Vision_Length_521_CAN3 /end REF_MEASUREMENT /end GROUP
/begin GROUP Root_variable_out71 "truck_adas/variable_out71" /begin REF_MEASUREMENT Radar_LonPos_534_CAN3 /end REF_MEASUREMENT /end GROUP
/begin GROUP Root_variable_out72 "truck_adas/variable_out72" /begin REF_MEASUREMENT FLC_UPA_Distance_51_535_CAN3 /end REF_MEASUREMENT /end GROUP
/begin GROUP Root_variable_out73 "truck_adas/variable_out73" /begin REF_MEASUREMENT FLC_UPA_Status_51_535_CAN3 /end REF_MEASUREMENT /end GROUP
/begin GROUP Root_variable_out74 "truck_adas/variable_out74" /begin REF_MEASUREMENT FLM_UPA_Distance_51_535_CAN3 /end REF_MEASUREMENT /end GROUP
/begin GROUP Root_variable_out75 "truck_adas/variable_out75" /begin REF_MEASUREMENT FLM_UPA_Status_51_535_CAN3 /end REF_MEASUREMENT /end GROUP
/begin GROUP Root_variable_out76 "truck_adas/variable_out76" /begin REF_MEASUREMENT FRC_UPA_Distance_51_535_CAN3 /end REF_MEASUREMENT /end GROUP
/begin GROUP Root_variable_out77 "truck_adas/variable_out77" /begin REF_MEASUREMENT FRC_UPA_Status_51_535_CAN3 /end REF_MEASUREMENT /end GROUP
/begin GROUP Root_variable_out78 "truck_adas/variable_out78" /begin REF_MEASUREMENT FRM_UPA_Distance_51_535_CAN3 /end REF_MEASUREMENT /end GROUP
/begin GROUP Root_variable_out79 "truck_adas/variable_out79" /begin REF_MEASUREMENT FRM_UPA_Status_51_535_CAN3 /end REF_MEASUREMENT /end GROUP
/begin GROUP Root_variable_out9 "truck_adas/variable_out9" /begin REF_MEASUREMENT ADAS_vel_cur_520_CAN3 /end REF_MEASUREMENT /end GROUP
/begin GROUP S1_D2_OUTPUT "truck_adas/TRUCK_ADAS/D2_OUTPUT"
 /begin REF_MEASUREMENT ADAS_HeartBeat_512_CAN3 ADAS_Stat_st_533_CAN3 ADAS_work_st_512_CAN3 Deta_530_CAN3 Obs_533_CAN3 SteerAngle_desire_512_CAN3 Temp_1_537_CAN3 Temp_2_537_CAN3 Temp_3_537_CAN3 Temp_4_537_CAN3 VelSpd_desire_512_CAN3 /end REF_MEASUREMENT
/end GROUP
/begin GROUP S1_D3_Vehicle "truck_adas/TRUCK_ADAS/D3 Vehicle"
 /begin SUB_GROUP S161_D3_1_VehAcs S161_D3_3_Vehicle_Coordinator S161_D3_5_VehDa_ /end SUB_GROUP
/end GROUP
/begin GROUP S1_D4__Fusion_perception "truck_adas/TRUCK_ADAS/D4  Fusion perception" /begin SUB_GROUP S162_D4_2__Static_object_synthesis_detection_ /end SUB_GROUP /end GROUP
/begin GROUP S1_D5_ADAS "truck_adas/TRUCK_ADAS/D5_ADAS" /begin SUB_GROUP S163_D5_10_Driving S163_D5_5___AEB /end SUB_GROUP /end GROUP
/begin GROUP S1_D6_DSM "truck_adas/TRUCK_ADAS/D6 DSM" /begin SUB_GROUP S164_debouncing /end SUB_GROUP /end GROUP
/begin GROUP S161_D3_1_VehAcs "truck_adas/TRUCK_ADAS/D3 Vehicle/D3.1 VehAcs"
 /begin SUB_GROUP S180_D3_1_2__VehAcs_IgnKey S180_D3_1_3__VehAcs_Disp__WarnningLamp /end SUB_GROUP
/end GROUP
/begin GROUP S161_D3_3_Vehicle_Coordinator "truck_adas/TRUCK_ADAS/D3 Vehicle/D3.3 Vehicle_Coordinator" /begin SUB_GROUP S182_D3_3_2_VehStatCo_Stat_counter /end SUB_GROUP
 /begin REF_CHARACTERISTIC Veh_FINISH Veh_READY Veh_RUNNING Veh_STANDBY Veh_START Veh_STOPPING /end REF_CHARACTERISTIC
 /begin REF_MEASUREMENT VehStatCo_Stat_st_532_CAN3 /end REF_MEASUREMENT
/end GROUP
/begin GROUP S161_D3_5_VehDa_ "truck_adas/TRUCK_ADAS/D3 Vehicle/D3.5 VehDa " /begin SUB_GROUP S183__D3_5_2_VehDa_VehSpd_SigFilter /end SUB_GROUP /end GROUP
/begin GROUP S162_D4_2__Static_object_synthesis_detection_ "truck_adas/TRUCK_ADAS/D4  Fusion perception/D4.2  Static object synthesis detection " /begin SUB_GROUP S250_D4_2_1__Vision_Obj_distance /end SUB_GROUP /end GROUP
/begin GROUP S163_D5_10_Driving "truck_adas/TRUCK_ADAS/D5_ADAS/D5.10 Driving" /begin REF_MEASUREMENT Driving_state_530_CAN3 /end REF_MEASUREMENT /end GROUP
/begin GROUP S163_D5_5___AEB "truck_adas/TRUCK_ADAS/D5_ADAS/D5.5   AEB" /begin SUB_GROUP S305_D5_5_1_Accelation /end SUB_GROUP /end GROUP
/begin GROUP S164_debouncing "truck_adas/TRUCK_ADAS/D6 DSM/debouncing" /begin REF_MEASUREMENT Dfp_mp_532_CAN3 /end REF_MEASUREMENT /end GROUP
/begin GROUP S180_D3_1_2__VehAcs_IgnKey "truck_adas/TRUCK_ADAS/D3 Vehicle/D3.1 VehAcs/D3.1.2  VehAcs_IgnKey" /begin REF_MEASUREMENT VehAcs_IgnKey_st_532_CAN3 /end REF_MEASUREMENT /end GROUP
/begin GROUP S180_D3_1_3__VehAcs_Disp__WarnningLamp "truck_adas/TRUCK_ADAS/D3 Vehicle/D3.1 VehAcs/D3.1.3  VehAcs_Disp__WarnningLamp" /begin REF_MEASUREMENT WarnningLamp_532_CAN3 /end REF_MEASUREMENT /end GROUP
/begin GROUP S182_D3_3_2_VehStatCo_Stat_counter "truck_adas/TRUCK_ADAS/D3 Vehicle/D3.3 Vehicle_Coordinator/D3.3.2 VehStatCo_Stat_counter" /begin REF_CHARACTERISTIC VehStatCo_Stat_DT /end REF_CHARACTERISTIC
 /begin REF_MEASUREMENT VehStatCo_Stat_tiAftRun_533_CAN3 VehStatCo_Stat_tiCrank_532_CAN3 VehStatCo_Stat_tiNrm_532_CAN3 /end REF_MEASUREMENT
/end GROUP
/begin GROUP S183__D3_5_2_VehDa_VehSpd_SigFilter "truck_adas/TRUCK_ADAS/D3 Vehicle/D3.5 VehDa / D3.5.2 VehDa_VehSpd_SigFilter" /begin REF_MEASUREMENT VehDa_VehSpd_a_532_CAN3 VehDa_VehSpd_vel_532_CAN3 /end REF_MEASUREMENT /end GROUP
/begin GROUP S250_D4_2_1__Vision_Obj_distance "truck_adas/TRUCK_ADAS/D4  Fusion perception/D4.2  Static object synthesis detection /D4.2.1  Vision_Obj_distance" /begin SUB_GROUP S260_Obj_dis_vision /end SUB_GROUP /end GROUP
/begin GROUP S305_D5_5_1_Accelation "truck_adas/TRUCK_ADAS/D5_ADAS/D5.5   AEB/D5.5.1 Accelation" /begin REF_MEASUREMENT Time_difference_530_CAN3 /end REF_MEASUREMENT /end GROUP
/begin GROUP S260_Obj_dis_vision "truck_adas/TRUCK_ADAS/D4  Fusion perception/D4.2  Static object synthesis detection /D4.2.1  Vision_Obj_distance/Obj_dis_vision" /begin REF_MEASUREMENT Obj_distance_vision_534_CAN3 /end REF_MEASUREMENT /end GROUP
/end MODULE
/end PROJECT
/* (add any file trailer comments here) */
/* EOF truck_adas.a2l */
